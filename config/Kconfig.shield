## config/Kconfig.shield
```kconfig
# Copyright (c) 2020 The ZMK Contributors
# SPDX-License-Identifier: MIT

# Idea from: https://github.com/zmkfirmware/zmk/blob/main/app/boards/shields/kyria/Kconfig.shield

config SHIELD_KRETSTRAD
    bool

config SHIELD_KRETSTRAD_LEFT
    def_bool $(shields_list_contains,kretstrad_left)
    select SHIELD_KRETSTRAD

config SHIELD_KRETSTRAD_RIGHT
    def_bool $(shields_list_contains,kretstrad_right)
    select SHIELD_KRETSTRAD

config SHIELD_KRETSTRAD_V2_LEFT
    def_bool $(shields_list_contains,boards/shield/kretstrad_v2/kretstrad_v2_left)
    select SHIELD_KRETSTRAD

config SHIELD_KRETSTRAD_V2_RIGHT
    def_bool $(shields_list_contains,boards/shield/kretstrad_v2/kretstrad_v2_right)
    select SHIELD_KRETSTRAD
```

## config/boards/shields/kretstrad/Kconfig.defconfig
```kconfig
# Copyright (c) 2020 The ZMK Contributors
# SPDX-License-Identifier: MIT

config ZMK_KEYBOARD_NAME
	default "Kretstrad"

if SHIELD_KRETSTRAD_RIGHT

config ZMK_SPLIT_ROLE_CENTRAL
	default y

endif

if SHIELD_KRETSTRAD_LEFT || SHIELD_KRETSTRAD_RIGHT

config ZMK_SPLIT
	default y

endif
```

## config/boards/shields/kretstrad/Kconfig.shield
```kconfig
# Copyright (c) 2020 The ZMK Contributors
# SPDX-License-Identifier: MIT

config SHIELD_KRETSTRAD_LEFT
    def_bool $(shields_list_contains,kretstrad_left)

config SHIELD_KRETSTRAD_RIGHT
    def_bool $(shields_list_contains,kretstrad_right)
```

## config/boards/shields/kretstrad_v2/Kconfig.defconfig
```kconfig
# Copyright (c) 2020 The ZMK Contributors
# SPDX-License-Identifier: MIT

config ZMK_KEYBOARD_NAME
	default "Kretstrad"

config ZMK_SPLIT
	default y

if SHIELD_KRETSTRAD_V2_LEFT

config ZMK_SPLIT_ROLE_CENTRAL
	default y

endif
```

## config/boards/shields/kretstrad_v2/Kconfig.shield
```kconfig
# Copyright (c) 2020 The ZMK Contributors
# SPDX-License-Identifier: MIT

# Idea from: https://github.com/zmkfirmware/zmk/blob/main/app/boards/shields/kyria/Kconfig.shield

config SHIELD_KRETSTRAD_V2_LEFT
    def_bool $(shields_list_contains,kretstrad_v2_left)

config SHIELD_KRETSTRAD_V2_RIGHT
    def_bool $(shields_list_contains,kretstrad_v2_right)
```

## config/west.yml
```yaml
manifest:
  remotes:
    - name: zmkfirmware
      url-base: https://github.com/zmkfirmware

    - name: caksoylar
      url-base: https://github.com/caksoylar

  projects:
    - name: zmk
      remote: zmkfirmware
      revision: v0.3
      import: app/west.yml

    - name: zmk-rgbled-widget  # <-- new entry
      url: https://github.com/caksoylar/zmk-rgbled-widget
      revision: v0.3           # MUST match your ZMK version!

  self:
    path: config
```
